/*@!Encoding:1250*/
includes
{
  //zmiana testowa
}

variables
{
}

on start
{

}





