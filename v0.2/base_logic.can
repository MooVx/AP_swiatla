/*@!Encoding:1250*/
includes
{
  #include "const.cin"
  #include "func_base.cin"
  
}

variables
{
  msTimer mig;   //pedestrian blinking green lights timer 
  msTimer cycl;  //main cycle timer
  timer req;
  int off_blink;

  message Display panel;   //frame to display state on panel
  message Time t_msg;
  message Sensor sens;
  message CONTROL ctrl_msg;

  int state=0;

  int T[28]={1, 8, 4, 1, 3, 1, 0, 1, 1, 8, 3, 1, 1, 8, 3, 1, 1, 7, 4, 1, 1, 8, 3, 1, 1, 8, 3, 1};

  int adv_work=0;
  int tact=0;
  int anim_multiplier =200;

}



on start
{   
  // first call of timers at simulatoin start:
  setTimer(cycl,100); 
  setTimer(mig,50); 
  ctrl_msg.byte(0)=0x11;  // 0b0001 0001  base_req & good signal
  output(ctrl_msg);
  
}


on message CONTROL
{
  ctrl_msg=this;
  if(this._ADV_REQUEST==1)
    adv_work=1; 
  if(this._OFF==1){
    off_blink=1;
  }else
    off_blink=0;
    
  setTimer(req,10); 
  
}

on message Sensor
{
  sens=this;
}

on message Time
{
  t_msg=this;
  time_message_parser(this);
}


on timer req
{
  adv_work=0;
  ctrl_msg.byte(0)=0x02;   // 0b0000 0010  base_error
  output(ctrl_msg);
}

on timer mig
{ 
  if(state==F1_S3){     //E green light should blink 
    panel.E_G^=1;   // modify signal E_green in frame panel ( toggle - XOR func.)
    output(panel);  //send message over CAN
  };
  if(state==F4_S3){    //E&F green light should blink 
    panel.E_G^=1;   // modify signal E_green in frame panel ( toggle - XOR func.)
    panel.F_G^=1;   // modify signal F_green in frame panel ( toggle - XOR func.)
    output(panel);  //send message over CAN
  }
    
  setTimer(mig,100); //request 'mig' timer event after 100ms 
}



on timer cycl
{
  if(off_blink==0){
    if(adv_work==1){
      setTimer(cycl,anim_multiplier*T_stand[state]);  //request 'mig' timer event after 500*T[state] ms
      display_state(state);
      state=calc_state();
      if(state==F2_S1)
        state=calc_state();
    }
    else{ 
      setTimer(cycl,anim_multiplier*T_stand[state]);  //request 'mig' timer event after 500*T[state] ms
      display_state(state);
      state++;  
      if(state==28)
        state=F1_S1;
    }
        
    ctrl_msg.byte(0)=0x11;  // 0b0001 0001  base_req & good signal
    output(ctrl_msg);
  }
  else{
      if(tact)
        display_state(F0_S0);
      else
        display_state(F0_S1);
      if(tact)
        tact=0;
      else
        tact=1; 
      setTimer(cycl,anim_multiplier);
      ctrl_msg.byte(0)=0x51;  // 0b0101 0001  off & base_req & good signal
      output(ctrl_msg);
  }
  write("stan: %d",state);
}



